## boards/shields/totem/Kconfig.defconfig
```kconfig
# all
config ZMK_BLE
	default y

config ZMK_SPLIT
    default y

config ZMK_USB
    default y

# dongle
if SHIELD_TOTEM_DONGLE

config ZMK_SPLIT_BLE_CENTRAL_PERIPHERALS
    default 2

endif

# norm_left
if SHIELD_TOTEM_NORM_LEFT

config ZMK_SPLIT_BLE_CENTRAL_PERIPHERALS
    default 1

endif

# central/main
if SHIELD_TOTEM_DONGLE || SHIELD_TOTEM_NORM_LEFT

config ZMK_KEYBOARD_NAME
    default "SASTOT"

config ZMK_SPLIT_ROLE_CENTRAL
    default y

endif

if SHIELD_TOTEM_DONGLE_LEFT || SHIELD_TOTEM_DONGLE_RIGHT || SHIELD_TOTEM_NORMAL_RIGHT

config ZMK_SPLIT_ROLE_CENTRAL
    default n

endif
```

## boards/shields/totem/Kconfig.shield
```kconfig
config SHIELD_TOTEM_NORM_LEFT
  def_bool $(shields_list_contains, totem_normal_left)
config SHIELD_TOTEM_NORM_RIGHT
  def_bool $(shields_list_contains, totem_normal_right)

config SHIELD_TOTEM_DONGLE_LEFT
  def_bool $(shields_list_contains, totem_dongle_left)
config SHIELD_TOTEM_DONGLE_RIGHT
  def_bool $(shields_list_contains, totem_dongle_right)
config SHIELD_TOTEM_DONGLE
  def_bool $(shields_list_contains, totem_dongle)
```
